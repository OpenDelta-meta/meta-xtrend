## conf/machine/et10000.conf
```bitbake
#@TYPE: Machine
#@NAME: et10000
#@DESCRIPTION: Machine configuration for the et10000

SOC_FAMILY = "bcm7425"
CHIPSET = "bcm7425"

BRAND_OEM = "xtrend"
MACHINE_BRAND = "Xtrend"
MACHINE_NAME = "ET10000"

KERNEL_FILE = "kernel.bin"
ROOTFS_FILE = "rootfs.bin"
MTD_KERNEL = "mtd1"
MTD_ROOTFS = "mtd2"

MACHINE_FEATURES += " dvb-c fanctrl bwlcd128 transcoding multitranscoding videoenhancement ci skins1080 wol v3d-mipsel wifi-kernel4 SCART YUV HDMI HDMI-IN-HD"
OPENPLI_FEATURES += " kodi"
DISTRO_FEATURES:remove = "x11 wayland directfb"

MKUBIFS_ARGS = "-m 2048 -e 126976 -c 8192"
UBINIZE_ARGS = "-m 2048 -p 128KiB"

RCTYPE = "9"

PREFERRED_VERSION_linux-et = "4.10.6"
require conf/machine/include/et-mipsel.inc
```

## conf/machine/et4x00.conf
```bitbake
#@TYPE: Machine
#@NAME: et4000
#@DESCRIPTION: Machine configuration for the et4000

SOC_FAMILY = "bcm7358"
CHIPSET = "bcm7358"

BRAND_OEM = "xtrend"
MACHINE_BRAND = "Xtrend"
MACHINE_NAME = "ET4X00"

KERNEL_FILE = "kernel.bin"
ROOTFS_FILE = "rootfs.bin"
MTD_KERNEL = "mtd1"
MTD_ROOTFS = "mtd2"

MACHINE_FEATURES += " wifi-kernel4 videoenhancement smallflash SCART HDMI RCA"
DISTRO_FEATURES:remove = "x11 wayland directfb"

MKUBIFS_ARGS = "-m 2048 -e 126976 -c 4096"
UBINIZE_ARGS = "-m 2048 -p 128KiB"

RCTYPE = "13"

PREFERRED_VERSION_linux-et = "4.10.6"
require conf/machine/include/et-mipsel.inc
```

## conf/machine/et6x00.conf
```bitbake
#@TYPE: Machine
#@NAME: Xtrend et6x00
#@DESCRIPTION: Machine configuration for the Xtrend et6x00

SOC_FAMILY = "bcm7413"
CHIPSET = "bcm7413"

BRAND_OEM = "xtrend"
MACHINE_BRAND = "Xtrend"
MACHINE_NAME = "ET6X00"

KERNEL_FILE = "kernel.bin"
ROOTFS_FILE = "rootfs.bin"
MTD_KERNEL = "mtd1"
MTD_ROOTFS = "mtd2"

MACHINE_FEATURES += " micom videoenhancement blindscan-dvbs textlcd 7segment skins1080 smallflash HDMI SCART NO_SCART_SWITCH YUV"
DISTRO_FEATURES:remove = "x11 wayland directfb"

MKUBIFS_ARGS = "-m 2048 -e 126976 -c 4096"
UBINIZE_ARGS = "-m 2048 -p 128KiB"

RCTYPE = "9"

PREFERRED_PROVIDER_virtual/blindscan-dvbs = "et-blindscan-dvbs-utils"
PREFERRED_VERSION_linux-et = "3.8.7"
require conf/machine/include/et-mipsel.inc
```

## conf/machine/et7x00.conf
```bitbake
#@TYPE: Machine
#@NAME: et7x00
#@DESCRIPTION: Machine configuration for the et7x00

SOC_FAMILY = "bcm73625"
CHIPSET = "bcm73625"

BRAND_OEM = "xtrend"
MACHINE_BRAND = "Xtrend"
MACHINE_NAME = "ET7X00"

KERNEL_FILE = "kernel.bin"
ROOTFS_FILE = "rootfs.bin"
MTD_KERNEL = "mtd1"
MTD_ROOTFS = "mtd2"

MACHINE_FEATURES += " ci textlcd videoenhancement blindscan-dvbs blindscan-dvbc dvb-c skins1080 h265 HDMI RCA"
DISTRO_FEATURES:remove = "x11 wayland directfb"

MKUBIFS_ARGS = "-m 2048 -e 126976 -c 8192"
UBINIZE_ARGS = "-m 2048 -p 128KiB"

PREFERRED_VERSION_linux-et-nextv = "4.4.8"
require conf/machine/include/et-nextv-mipsel.inc
```

## conf/machine/et8000.conf
```bitbake
#@TYPE: Machine
#@NAME: et8000
#@DESCRIPTION: Machine configuration for the et8000

SOC_FAMILY = "bcm7241"
CHIPSET = "bcm7241"

BRAND_OEM = "xtrend"
MACHINE_BRAND = "Xtrend"
MACHINE_NAME = "ET8000"

KERNEL_FILE = "kernel.bin"
ROOTFS_FILE = "rootfs.bin"
MTD_KERNEL = "mtd1"
MTD_ROOTFS = "mtd2"

MACHINE_FEATURES += " wifi-kernel4 dvb-c textlcd ci transcoding fanctrl videoenhancement blindscan-dvbc skins1080 HDMI SCART SCART-YUV TIMERWAKEUP RCA"
DISTRO_FEATURES:remove = "x11 wayland directfb"

MKUBIFS_ARGS = "-m 2048 -e 126976 -c 8192"
UBINIZE_ARGS = "-m 2048 -p 128KiB"

RCTYPE = "9"

PREFERRED_VERSION_linux-et = "4.10.6"
require conf/machine/include/et-mipsel.inc
```

## conf/machine/et8500.conf
```bitbake
#@TYPE: Machine
#@NAME: et8500
#@DESCRIPTION: Machine configuration for the et8500

SOC_FAMILY = "bcm7429"
CHIPSET = "bcm7429"

BRAND_OEM = "xtrend"
MACHINE_BRAND = "Xtrend"
MACHINE_NAME = "ET8500"

KERNEL_FILE = "kernel.bin"
ROOTFS_FILE = "rootfs.bin"
MTD_KERNEL = "mtd1"
MTD_ROOTFS = "mtd2"

MACHINE_FEATURES += " dvb-c colorlcd720 ci fanctrl blindscan-dvbc skins1080 HDMI RCA"
DISTRO_FEATURES:remove = "x11 wayland directfb"

MKUBIFS_ARGS = "-m 2048 -e 126976 -c 8192"
UBINIZE_ARGS = "-m 2048 -p 128KiB"

PREFERRED_VERSION_linux-et-nextv = "4.4.8"
require conf/machine/include/et-nextv-mipsel.inc
```

## conf/machine/et9x00.conf
```bitbake
#@TYPE: Machine
#@NAME: Xtrend et9x00
#@DESCRIPTION: Machine configuration for the Xtrend et9x00

SOC_FAMILY = "bcm7413"
CHIPSET = "bcm7413"

BRAND_OEM = "xtrend"
MACHINE_BRAND = "Xtrend"
MACHINE_NAME = "ET9X00"

KERNEL_FILE = "kernel.bin"
ROOTFS_FILE = "rootfs.bin"
MTD_KERNEL = "mtd1"
MTD_ROOTFS = "mtd2"

MACHINE_FEATURES += " micom textlcd ci fanctrl blindscan-dvbs dvb-c skins1080 smallflash HDMI SCART YUV"
DISTRO_FEATURES:remove = "x11 wayland directfb"

MKUBIFS_ARGS = "-m 2048 -e 126976 -c 4096"
UBINIZE_ARGS = "-m 2048 -p 128KiB"

RCTYPE = "9"

PREFERRED_PROVIDER_virtual/blindscan-dvbs = "et-blindscan-dvbs-utils"
PREFERRED_VERSION_linux-et = "3.8.7"
require conf/machine/include/et-mipsel.inc
```

## conf/machine/include/et-essential.inc
```bitbake
MACHINE_ESSENTIAL_EXTRA_RRECOMMENDS = "\
	kernel-module-cdfs \
	${@bb.utils.contains('MACHINE_FEATURES', 'v3d-mipsel', 'et-v3ddriver-${MACHINE}' , '', d)} \
	${@bb.utils.contains('MACHINE_FEATURES', 'micom', 'et-fpupdate-${MACHINE}' , '', d)} \
	\
	${@bb.utils.contains('MACHINE_FEATURES', 'wifi-kernel4', 'firmware-rtl8192eu firmware-rtl8188eu firmware-rtl8xxxu firmware-mt7601u kernel-module-rtl88x2bu kernel-module-r8188eu kernel-module-8192eu kernel-module-mt7601u kernel-module-rtl8xxxu' , '', d)} \
	"
```

## conf/machine/include/et-nextv-essential.inc
```bitbake
MACHINE_ESSENTIAL_EXTRA_RRECOMMENDS = "\
	kernel-module-cdfs \
	${@bb.utils.contains('MACHINE_FEATURES', 'v3d-nxclient', 'nexttv-v3ddriver-${MACHINE}' , '', d)} \
	\
	firmware-rtl8192eu \
	firmware-rtl8188eu \
	firmware-rtl8xxxu \
	firmware-mt7601u \
	kernel-module-r8188eu \
	kernel-module-8192eu \
	kernel-module-mt7601u \
	kernel-module-rtl8xxxu \
	kernel-module-rtl88x2bu \
	"
```
